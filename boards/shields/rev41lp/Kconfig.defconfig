## boards/shields/rev41lp/Kconfig.defconfig
```kconfig
# Copyright (c) 2020 The ZMK Contributors
# SPDX-License-Identifier: MIT

if SHIELD_REV41LP

config ZMK_KEYBOARD_NAME
    default "rev41lp"

if ZMK_BACKLIGHT

config PWM
    default y

config LED_PWM
    default y

endif # ZMK_BACKLIGHT

endif # SHIELD_REV41LP
```

## config/boards/shields/rev41lp/Kconfig.shield
```kconfig
# Copyright (c) 2020 The ZMK Contributors
# SPDX-License-Identifier: MIT

config SHIELD_REV41LP
    def_bool $(shields_list_contains,rev41lp)
```
